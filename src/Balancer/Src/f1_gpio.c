//******************************************************************************
//  Секция include: здесь подключается заголовочный файл к модулю
//******************************************************************************

#include "f1_gpio.h"

//******************************************************************************
//  Секция определения переменных, используемых в модуле
//******************************************************************************

//------------------------------------------------------------------------------
// Глобальные
//------------------------------------------------------------------------------


//------------------------------------------------------------------------------
// Локальные
//------------------------------------------------------------------------------

static gpio_config_t * gpio_p   = NULL;
static uint8_t         gpio_num = 0;

//******************************************************************************
//  Секция прототипов локальных функций
//******************************************************************************



//******************************************************************************
//  Секция описания функций (сначала глобальных, потом локальных)
//******************************************************************************

/*******************************************************************************
*  Function:       gpioInit
*-------------------------------------------------------------------------------
*  description:
*  parameters:     void
*  on return:      void
*******************************************************************************/
void gpioInit(const gpio_config_t * cfg, uint8_t num)
{
	GPIO_InitTypeDef GPIO_InitStruct;

	gpio_num = num;
	gpio_p = cfg;

	for (uint8_t i = 0; i < gpio_num; i++)
	{
	    gpioClockEnable(gpio_p[i].gpio);                                     /* GPIO Ports Clock Enable */

		GPIO_InitStruct.Pin   = gpio_p[i].Pin;                               /* Configure gpio pin */
		GPIO_InitStruct.Mode  = gpio_p[i].Mode;
		GPIO_InitStruct.Pull  = gpio_p[i].Pull;
		GPIO_InitStruct.Speed = gpio_p[i].Speed;
		HAL_GPIO_Init(gpio_p[i].gpio, &GPIO_InitStruct);
	}

}

/*******************************************************************************
*  Function:       gpioHi
*-------------------------------------------------------------------------------
*  description:
*  parameters:     void
*  on return:      void
*******************************************************************************/
void gpioHi(uint8_t gpio_id)
{
	if (gpio_p && (gpio_id < gpio_num))
		HAL_GPIO_WritePin(gpio_p[gpio_id].gpio, gpio_p[gpio_id].Pin, SET);
}

/*******************************************************************************
*  Function:       gpioLo
*-------------------------------------------------------------------------------
*  description:
*  parameters:     void
*  on return:      void
*******************************************************************************/
void gpioLo(uint8_t gpio_id)
{
	if (gpio_p && (gpio_id < gpio_num))
		HAL_GPIO_WritePin(gpio_p[gpio_id].gpio, gpio_p[gpio_id].Pin, RESET);
}

/*******************************************************************************
*  Function:       gpioToggle
*-------------------------------------------------------------------------------
*  description:
*  parameters:     void
*  on return:      void
*******************************************************************************/
void gpioToggle(uint8_t gpio_id)
{
	if (gpio_p && (gpio_id < gpio_num))
	    HAL_GPIO_TogglePin(gpio_p[gpio_id].gpio, gpio_p[gpio_id].Pin);
}

void gpioClockEnable(GPIO_TypeDef  *GPIOx)
{
	     if (GPIOx == GPIOA)	__HAL_RCC_GPIOA_CLK_ENABLE();
	else if (GPIOx == GPIOB)	__HAL_RCC_GPIOB_CLK_ENABLE();
	else if (GPIOx == GPIOC)	__HAL_RCC_GPIOC_CLK_ENABLE();
	else if (GPIOx == GPIOD)	__HAL_RCC_GPIOD_CLK_ENABLE();
}


//******************************************************************************
//  ENF OF FILE
//******************************************************************************
